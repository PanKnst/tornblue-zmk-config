## config/west.yml
```yaml
manifest:
  remotes:
    - name: YiotiCB
      url-base: https://github.com/YiotiCB
  projects:
    - name: zmk
      remote: YiotiCB
      revision: main
      import: app/west.yml
  self:
    path: config
```
